/dts-v1/;
/plugin/;

/ {
	compatible = "allwinner,sun50i-h616-mali\0arm,mali-bifrost";
        fragment@0 {
		target-path = "/soc/gpu@1800000";
		__overlay__ {
		status = "disabled";
			    };
                   };
  };
