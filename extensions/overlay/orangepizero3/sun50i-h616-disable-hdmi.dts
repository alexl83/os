/dts-v1/;
/plugin/;

/ {
	compatible = "allwinner,sun50i-h616-dw-hdmi\0allwinner,sun50i-h6-dw-hdmi";
        fragment@0 {
		target-path = "/soc/hdmi@6000000";
		__overlay__ {
		status = "disabled";
			    };
                   };
  };
